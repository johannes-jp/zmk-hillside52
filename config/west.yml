## config/west.yml
```yaml
manifest:
  remotes:
    - name: johannes-jp
      url-base: https://github.com/johannes-jp
    # Additional modules containing boards/shields/custom code can be listed here as well
    - name: urob
      url-base: https://github.com/urob
    # See https://docs.zephyrproject.org/3.2.0/develop/west/manifest.html#projects
  projects:
    - name: zmk
      remote: johannes-jp
      revision: main
      import: app/west.yml
    - name: zmk-helpers
      remote: urob
      revision: main
  self:
    path: config
```
